## main/Kconfig.projbuild
```kconfig
menu "Example Configuration"

    config I2C_MASTER_SCL
        int "SCL GPIO Num"
        default 9 if IDF_TARGET_ESP32C3
        default 19 if IDF_TARGET_ESP32 || IDF_TARGET_ESP32S2 || IDF_TARGET_ESP32S3
        help
            GPIO number for I2C Master clock line.

    config I2C_MASTER_SDA
        int "SDA GPIO Num"
        default 8 if IDF_TARGET_ESP32C3
        default 18 if IDF_TARGET_ESP32 || IDF_TARGET_ESP32S2 || IDF_TARGET_ESP32S3
        help
            GPIO number for I2C Master data line.

endmenu
```
